// SPDX-License-Identifier: GPL-2.0-only
/*
 * Copyright (C) 2024 Ryan Agius - ryagius17@gmail.com
 */
/dts-v1/;

#include "am335x-boneblack.dts"

/ {
	model = "Ryan's TI AM335x BeagleBone Black";
	compatible = "ti,am335x-bone-black", "ti,am335x-bone", "ti,am33xx";
};
